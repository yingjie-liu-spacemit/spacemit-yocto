## meta-k1/conf/layer.conf
```bitbake
# We have a conf and classes directory, add to BBPATH
BBPATH .= ":${LAYERDIR}"

# We have recipes-* directories, add to BBFILES
BBFILES += "${LAYERDIR}/recipes-*/*/*.bb \
            ${LAYERDIR}/recipes-*/*/*.bbappend"

BBFILE_COLLECTIONS += "meta-k1"
BBFILE_PATTERN_meta-k1 = "^${LAYERDIR}/"
BBFILE_PRIORITY_meta-k1 = "6"

LAYERDEPENDS_meta-k1 = "core"
LAYERSERIES_COMPAT_meta-k1 = "scarthgap"
```

## meta-k1/conf/machine/k1.conf
```bitbake
# K1 Board Machine Configuration

# Use meta-riscv common includes for TUNE and arch settings
require conf/machine/include/riscv-common.inc

# Include graphics provider preferences
require conf/machine/include/k1-graphics.inc

# Kernel configuration
KERNEL_CLASSES = "kernel"
KERNEL_IMAGETYPE = "Image"
PREFERRED_PROVIDER_virtual/kernel = "linux-k1-dev"
PREFERRED_VERSION_linux-k1-dev = "6.6"

# U-Boot configuration
PREFERRED_PROVIDER_virtual/bootloader = "u-boot-k1"
PREFERRED_PROVIDER_u-boot = "u-boot-k1"
PREFERRED_VERSION_u-boot-k1 = "2022.10"
UBOOT_MACHINE = "k1_defconfig"

# OpenSBI configuration
PREFERRED_PROVIDER_opensbi = "opensbi-k1"
PREFERRED_VERSION_opensbi-k1 = "1.3"

# Image configuration
IMAGE_FSTYPES = "ext4 wic"
WKS_FILE = "k1.wks"

# Machine features
MACHINE_FEATURES:append = " usbhost usbgadget"

# Device tree files
KERNEL_DEVICETREE = " \
    spacemit/k1-x_baton-camera.dtb \
    spacemit/k1-x_deb1.dtb \
    spacemit/k1-x_deb2.dtb \
    spacemit/k1-x_evb.dtb \
    spacemit/k1-x_FusionOne.dtb \
    spacemit/k1-x_lpi3a.dtb \
    spacemit/k1-x_LX-V10.dtb \
    spacemit/k1-x_milkv-jupiter.dtb \
    spacemit/k1-x_MINI-PC.dtb \
    spacemit/k1-x_MUSE-Book.dtb \
    spacemit/k1-x_MUSE-Card.dtb \
    spacemit/k1-x_MUSE-N1.dtb \
    spacemit/k1-x_MUSE-Paper2.dtb \
    spacemit/k1-x_MUSE-Paper-mini-4g.dtb \
    spacemit/k1-x_MUSE-Pi.dtb \
    spacemit/k1-x_MUSE-Pi-Pro.dtb \
    spacemit/k1-x_som.dtb \
    spacemit/k1-x_uav.dtb \
    spacemit/k1-x_ZT001H.dtb \
    spacemit/m1-x_milkv-jupiter.dtb \
"
```

## meta-k1/wic/k1.wks
```
# K1 SD Card Image WIC Configuration (Precision Label Match)
# This WIC configuration creates a GPT-partitioned SD card image for K1, with bootinfo injected via k1-image.inc post-processing

bootloader --ptable gpt

part --part-name fsbl --source rawcopy --sourceparams="file=FSBL.bin" --fixed-size 256K --align 128

part --part-name env --source rawcopy --sourceparams="file=u-boot-env-default.bin" --fixed-size 64K --align 384

part --part-name opensbi --source rawcopy --sourceparams="file=fw_dynamic.itb" --fixed-size 384K --align 1024

part --part-name uboot --source rawcopy --sourceparams="file=u-boot.itb" --fixed-size 2M --align 2048

part --part-name bootfs --source rawcopy --sourceparams="file=bootfs.ext4" --fixed-size 256M --align 4096

part --part-name rootfs --source rootfs --fstype=ext4 --label root --align 266240
```
